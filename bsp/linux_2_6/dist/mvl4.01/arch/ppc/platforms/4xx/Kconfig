## bsp/linux_2_6/dist/mvl4.01/arch/ppc/platforms/4xx/Kconfig
```kconfig
config 4xx
	bool
	depends on 40x || 44x
	default y

menu "IBM 4xx options"
	depends on 4xx

choice
	prompt "Machine Type"
	depends on 40x
	default XILINX_ML40x

config ASH
	bool "Ash"
	help
	  This option enables support for the IBM NP405H evaluation board.

config BUBINGA
	bool "Bubinga"
	help
	  This option enables support for the IBM 405EP evaluation board.

config CPCI405
	bool "CPCI405"
	help
	  This option enables support for the CPCI405 board.

config EP405
	bool "EP405/EP405PC"
	help
	  This option enables support for the EP405/EP405PC boards.

config MEMEC_2VPX
	bool "Memec-2VPx"
	help
	  This option enables support for the Memec-2VP4/2VP7 boards.

config OAK
	bool "Oak"
	help
	  This option enables support for the IBM 403GCX evaluation board.

config REDWOOD_5
	bool "Redwood-5"
	help
	  This option enables support for the IBM STB04 evaluation board.

config REDWOOD_6
	bool "Redwood-6"
	help
	  This option enables support for the IBM STBx25xx evaluation board.

config SYCAMORE
	bool "Sycamore"
	help
	  This option enables support for the IBM PPC405GPr evaluation board.

config WALNUT
	bool "Walnut"
	help
	  This option enables support for the IBM PPC405GP evaluation board.

config XILINX_ML300
	bool "Xilinx-ML300"
	help
	  This option enables support for the Xilinx ML300 evaluation board.

config XILINX_ML40x
	bool "Xilinx-ML403/ML405/ML410 (w/o PCI)"
	help
	  This option enables support for Xilinx ML403/405/410 evaluation boards.

config XILINX_ML410
	bool "Xilinx-ML410 using PCI"
	select XILINX_ML40x
	help
	  This option enables support for the Xilinx ML410 (using PCI) evaluation board.


endchoice

choice
	prompt "Machine Type"
	depends on 44x
	default XILINX_ML507

config BAMBOO
	bool "Bamboo"
	help
	  This option enables support for the IBM PPC440EP evaluation board.

config YOSEMITE
	bool "Yosemite"
	help
	  This option enables support for the AMCC PPC440EP evaluation board.

config YELLOWSTONE
	bool "Yellowstone"
	help
	  This option enables support for the AMCC PPC440GR evaluation board.

config EBONY
	bool "Ebony"
	help
	  This option enables support for the IBM PPC440GP evaluation board.

config LUAN
	bool "Luan"
	help
	  This option enables support for the IBM PPC440SP evaluation board.

config OCOTEA
	bool "Ocotea"
	help
	  This option enables support for the IBM PPC440GX evaluation board.

config XILINX_ML507
	bool "Xilinx-ML507 PPC440 Developement Board"
	help
	  This option enables support for the Xilinx ML507 PPC440 developement
	  board.

config XILINX_ML510
	bool "Xilinx-ML510 using PCI"
	depends on 44x
	select XILINX_ML510
	help
	  This option enables support for the Xilinx ML510 (using PCI) evaluation board.

config XILINX_DISABLE_44x_CACHE
	depends on XILINX_ML510
	bool "Disable PPC440 caches"
	help
	  This option allows to disable the caches on the PPC440. Some early
	  PPC440 cores do not work with caches enabled. If you have any
	  problems running the ML507, try using this option.

config XILINX_FPU
	select PPC_FPU
	depends on XILINX_ML507 || XILINX_ML510
	bool "Enable Xilinx Soft FPU"
	help
	  This option eables the Xilinx Soft hardware FPU attached to the APU
	  interface of the PPC440 (requires DP_FULL FPU pcore).

config XILINX_FPU_SIIE_WORKAROUND
	depends on XILINX_FPU
	bool "Enable Xilinx Soft FPU spurious interrupt workaround"
	default y
	help
	  This option enables a workaround for a bug in the APU controller of
	  the PPC440 processor block in Virtex-5 FXT. See the answer record at
	  http://www.xilinx.com/support/answers/30579.htm for more details.

config XILINX_FPU_LOAD_CORRUPTION_WORKAROUND
        depends on XILINX_FPU
        bool "Enable Xilinx FPU prefetch workaround"
	default y
        help
	  This option enables a workaround for a bug in the APU controller of
	  the PPC440 processor block in Virtex-5 FXT. See the answer record at
	  http://www.xilinx.com/support/answers/30529.htm for more details.

config XILINX_FPU_ITLB_EXCEPTION_WORKAROUND
        depends on XILINX_FPU
        bool "Enable Xilinx FPU TLB instruction miss workaround"
	default y
        help
	  This option enables a workaround for a bug in the APU controller of
	  the PPC440 processor block in Virtex-5 FXT. See the answer record at
	  http://www.xilinx.com/support/answers/30570.htm for more details.


endchoice

config EP405PC
	bool "EP405PC Support"
	depends on EP405


# It's often necessary to know the specific 4xx processor type.
# Fortunately, it is implied (so far) from the board type, so we
# don't need to ask more redundant questions.
config NP405H
	bool
	depends on ASH
	default y

config 440EP
	bool
	depends on BAMBOO || YOSEMITE
	select PPC_FPU
	default y

config 440GP
	bool
	depends on EBONY
	default y

config 440GR
	bool
	depends on YELLOWSTONE
	default y

config 440GX
	bool
	depends on OCOTEA
	default y

config 440SP
	bool
	depends on LUAN
	default y

config 440
	bool
	depends on 440GP || 440SP || 440EP || 440GR
	default y

config 440A
	bool
	depends on 440GX
	default y

config IBM440EP_ERR42
	bool
	depends on 440EP || 440GR
	default y

# All 405-based cores up until the 405GPR and 405EP have this errata.
config IBM405_ERR77
	bool
	depends on 40x && !403GCX && !405GPR
	default y

# All 40x-based cores, up until the 405GPR and 405EP have this errata.
config IBM405_ERR51
	bool
	depends on 40x && !405GPR
	default y

config BOOKE
	bool
	depends on 44x
	default y

config IBM_OCP
	bool
	depends on ASH || BAMBOO || YOSEMITE || YELLOWSTONE || BUBINGA || CPCI405 || EBONY || EP405 || LUAN || OCOTEA || REDWOOD_5 || REDWOOD_6 || SYCAMORE || WALNUT
	default y

config XILINX_OCP
	bool
	depends on XILINX_VIRTEX
	default y

config IBM_EMAC4
	bool
	depends on 440GX || 440SP
	default y

config BIOS_FIXUP
	bool
	depends on BUBINGA || EP405 || SYCAMORE || WALNUT
	default y

config 403GCX
	bool
	depends OAK
	default y

config 405EP
	bool
	depends on BUBINGA
	default y

config 405GP
	bool
	depends on CPCI405 || EP405 || WALNUT
	default y

config 405GPR
	bool
	depends on SYCAMORE
	default y

config XILINX_VIRTEX_II_PRO
	bool
	depends on XILINX_ML300 || MEMEC_2VPX
	default y

config VIRTEX_II_PRO_TLB_FIX
	bool "Virtex-II Pro TLB bugfix"
	depends on XILINX_VIRTEX_II_PRO
	default n
	help
	  Early versions of the Xilinx Virtex-II Pro have a TLB errata where
	  only even numbered TLB entries work correctly.  Say Y here if
	  PVR == 0x20010820 || 0x20010860, or if your board crashes early
	  after enabling the MMU.

	  See Record #14052, solution #12 in the Xilinx answers database
	  http://www.xilinx.com/xlnx/xil_ans_display.jsp?getPagePath=14052

	  It is safe to say Y here, but there is a performance impact.
	  Say N if unsure.

config XILINX_VIRTEX_4_FX
	bool
	depends on XILINX_ML40x || XILINX_ML410
	default y

config XILINX_VIRTEX_5_FX
	bool
	depends on XILINX_ML507 || XILINX_ML510
	default y

config XILINX_VIRTEX
	bool
	depends on XILINX_VIRTEX_II_PRO || XILINX_VIRTEX_4_FX || XILINX_VIRTEX_5_FX
	default y

config STB03xxx
	bool
	depends on REDWOOD_5 || REDWOOD_6
	default y

config EMBEDDEDBOOT
	bool
	depends on EP405 || XILINX_ML300 || XILINX_ML40x || XILINX_ML410 || XILINX_ML507 || XILINX_ML510 || MEMEC_2VPX
	default y

config IBM_OPENBIOS
	bool
	depends on ASH || BUBINGA || REDWOOD_5 || REDWOOD_6 || SYCAMORE || WALNUT
	default y

config PPC4xx_DMA
	bool "PPC4xx DMA controller support"
	depends on 4xx

config PPC4xx_EDMA
	bool
	depends on !STB03xxx && PPC4xx_DMA
	default y

config PPC_GEN550
	bool
	depends on 4xx
	default y

config PM
	bool "Power Management support (EXPERIMENTAL)"
	depends on 4xx && EXPERIMENTAL

choice
	prompt "TTYS0 device and default console"
	depends on 40x || 44x
	default UART0_TTYS0

config UART0_TTYS0
	bool "UART0"

config UART0_TTYS1
	bool "UART1"

endchoice

config SERIAL_SICC
	bool "SICC Serial port support"
	depends on STB03xxx

config UART1_DFLT_CONSOLE
	bool
	depends on SERIAL_SICC && UART0_TTYS1
	default y

config SERIAL_SICC_CONSOLE
	bool
	depends on SERIAL_SICC && UART0_TTYS1
	default y
endmenu
```

## bsp/linux_2_6/dist/wrl2.0/arch/ppc/platforms/4xx/Kconfig
```kconfig
config 4xx
	bool
	depends on 40x || 44x
	default y

config WANT_EARLY_SERIAL
	bool
	select SERIAL_8250
	default n

menu "IBM 4xx options"
	depends on 4xx

choice
	prompt "Machine Type"
	depends on 40x
	default XILINX_ML403

config BUBINGA
	bool "Bubinga"
	select WANT_EARLY_SERIAL
	help
	  This option enables support for the IBM 405EP evaluation board.

config CPCI405
	bool "CPCI405"
	help
	  This option enables support for the CPCI405 board.

config EP405
	bool "EP405/EP405PC"
	help
	  This option enables support for the EP405/EP405PC boards.

config REDWOOD_5
	bool "Redwood-5"
	help
	  This option enables support for the IBM STB04 evaluation board.

config REDWOOD_6
	bool "Redwood-6"
	help
	  This option enables support for the IBM STBx25xx evaluation board.

config SYCAMORE
	bool "Sycamore"
	help
	  This option enables support for the IBM PPC405GPr evaluation board.

config WRSBC405GP
       bool "WRSBC405GP"
       help
         This option enables support the Wind River SBC405gp reference board.

config WALNUT
	bool "Walnut"
	help
	  This option enables support for the IBM PPC405GP evaluation board.

config XILINX_ML300
	bool "Xilinx-ML300"
	help
	  This option enables support for the Xilinx ML300 evaluation board.

config XILINX_ML403
	bool "Xilinx-ML403/ML405/ML410 (w/o PCI)"
	help
	  This option enables support for Xilinx ML403/405/410 evaluation boards.

config XILINX_ML410
	bool "Xilinx-ML410 using PCI"
	help
	  This option enables support for the Xilinx ML410 (using PCI) evaluation board.

endchoice

choice
	prompt "Machine Type"
	depends on 44x
	default XILINX_ML507

config BAMBOO
	bool "Bamboo"
	select WANT_EARLY_SERIAL
	help
	  This option enables support for the IBM PPC440EP evaluation board.

config EBONY
	bool "Ebony"
	select WANT_EARLY_SERIAL
	help
	  This option enables support for the IBM PPC440GP evaluation board.

config LUAN
	bool "Luan"
	select WANT_EARLY_SERIAL
	help
	  This option enables support for the IBM PPC440SP evaluation board.

config YUCCA
	bool "Yucca"
	select WANT_EARLY_SERIAL
	help
	  This option enables support for the AMCC PPC440SPe evaluation board.

config OCOTEA
	bool "Ocotea"
	select WANT_EARLY_SERIAL
	help
	  This option enables support for the IBM PPC440GX evaluation board.

config TAISHAN
	bool "Taishan"
	select WANT_EARLY_SERIAL
	help
	  This option enables support for the AMCC PPC440GX evaluation board.

config YELLOWSTONE
       bool "Yellowstone"
       select WANT_EARLY_SERIAL
       help
         This option enables support for the AMCC PPC440GR evaluation board.

config YOSEMITE
       bool "Yosemite"
       select WANT_EARLY_SERIAL
       help
         This option enables support for the AMCC PPC440EP evaluation board.

config XILINX_ML507
	bool "Xilinx-ML507 PPC440 Developement Board"
	help
	  This option enables support for the Xilinx ML507 PPC440 developement
	  board.
endchoice

config XILINX_DISABLE_44x_CACHE
	depends on XILINX_ML507
	bool "Disable PPC440 caches"
	default n
	help
	  This option allows to disable the caches on the PPC440. Some early
	  PPC440 cores do not work with caches enabled. If you have any
	  problems running the ML507, try using this option.

config XILINX_FPU
	select PPC_FPU
	depends on XILINX_ML507
	bool "Enable Xilinx Soft FPU"
	help
	  This option eables the Xilinx Soft hardware FPU attached to the APU
	  interface of the PPC440 (requires DP_FULL FPU pcore).

config XILINX_FPU_SIIE_WORKAROUND
	depends on XILINX_FPU
	bool "Enable Xilinx Soft FPU spurious interrupt workaround"
	default y
	help
	  This option enables a workaround for a bug in the APU controller of
	  the PPC440 processor block in Virtex-5 FXT. See the answer record at
	  http://www.xilinx.com/support/answers/30579.htm for more details.

config XILINX_FPU_LOAD_CORRUPTION_WORKAROUND
        depends on XILINX_FPU
        bool "Enable Xilinx FPU prefetch workaround"
	default y
        help
	  This option enables a workaround for a bug in the APU controller of
	  the PPC440 processor block in Virtex-5 FXT. See the answer record at
	  http://www.xilinx.com/support/answers/30529.htm for more details.

config XILINX_FPU_ITLB_EXCEPTION_WORKAROUND
        depends on XILINX_FPU
        bool "Enable Xilinx FPU TLB instruction miss workaround"
	default y
        help
	  This option enables a workaround for a bug in the APU controller of
	  the PPC440 processor block in Virtex-5 FXT. See the answer record at
	  http://www.xilinx.com/support/answers/30570.htm for more details.

config EP405PC
	bool "EP405PC Support"
	depends on EP405


# It's often necessary to know the specific 4xx processor type.
# Fortunately, it is implied (so far) from the board type, so we
# don't need to ask more redundant questions.
config NP405H
	bool
	depends on ASH
	default y

config 440EP
	bool
	depends on BAMBOO || YOSEMITE
	select PPC_FPU
	default y

config 440GP
	bool
	depends on EBONY
	default y

config 440GR
	bool
	depends on YELLOWSTONE
	default y

config 440GX
	bool
	depends on OCOTEA || TAISHAN
	default y

config 440SP
	bool
	depends on LUAN
	default y

config 440SPE
	bool
	depends on YUCCA
	default y

config 440
	bool
	depends on 440GP || 440SP || 440SPE || 440EP || 440GR
	default y

config 440A
	bool
	depends on 440GX
	default y

config IBM440EP_ERR42
	bool
	depends on 440EP || 440GR
	default y

# All 405-based cores up until the 405GPR and 405EP have this errata.
config IBM405_ERR77
	bool
	depends on 40x && !403GCX && !405GPR && !405EP
	default y

# All 40x-based cores, up until the 405GPR and 405EP have this errata.
config IBM405_ERR51
	bool
	depends on 40x && !405GPR && !405EP
	default y

config BOOKE
	bool
	depends on 44x
	default y

config IBM_OCP
	bool
	depends on ASH || BAMBOO || BUBINGA || CPCI405 || EBONY || EP405 || LUAN || YUCCA || OCOTEA || REDWOOD_5 || REDWOOD_6 || SYCAMORE || TAISHAN || WALNUT || YELLOWSTONE || YOSEMITE || WRSBC405GP
	default y

config IBM_EMAC4
	bool
	depends on 440GX || 440SP || 440SPE
	default y

config XILINX_OCP
        bool
        depends on XILINX_VIRTEX
        default y

config BIOS_FIXUP
	bool
	depends on BUBINGA || EP405 || SYCAMORE || WALNUT || CPCI405 || WRSBC405GP
	default y

# OAK doesn't exist but wanted to keep this around for any future 403GCX boards
config 403GCX
	bool
	depends on OAK
	default y

config 405EP
	bool
	depends on BUBINGA
	default y

config 405GP
	bool
	depends on CPCI405 || EP405 || WALNUT || WRSBC405GP
	default y

config 405GPR
	bool
	depends on SYCAMORE
	default y

config XILINX_VIRTEX_II_PRO
	bool
	depends on XILINX_ML300
	default y

config XILINX_VIRTEX_4_FX
	bool
	depends on XILINX_ML403 || XILINX_ML410
	default y

config XILINX_VIRTEX_5_FX
	bool
	depends on XILINX_ML507
	default y

config XILINX_VIRTEX
	bool
	depends on XILINX_VIRTEX_II_PRO || XILINX_VIRTEX_4_FX || XILINX_VIRTEX_5_FX
	default y

config STB03xxx
	bool
	depends on REDWOOD_5 || REDWOOD_6
	default y

config EMBEDDEDBOOT
	bool
	depends on EP405 || XILINX_ML300 || XILINX_ML403 || XILINX_ML410 || XILINX_ML507
	default y

config IBM_OPENBIOS
	bool
	depends on ASH || REDWOOD_5 || REDWOOD_6 || WRSBC405GP
	default y

config PPC4xx_DMA
	bool "PPC4xx DMA controller support"
	depends on 4xx

config PPC4xx_EDMA
	bool
	depends on !STB03xxx && PPC4xx_DMA
	default y

config PPC_GEN550
	bool
	depends on 4xx
	default y

choice
	prompt "TTYS0 device and default console"
	depends on 40x || 44x
	default UART0_TTYS0

config UART0_TTYS0
	bool "UART0"

config UART0_TTYS1
	bool "UART1"

endchoice

config SERIAL_SICC
	bool "SICC Serial port support"
	depends on STB03xxx

config UART1_DFLT_CONSOLE
	bool
	depends on SERIAL_SICC && UART0_TTYS1
	default y

config SERIAL_SICC_CONSOLE
	bool
	depends on SERIAL_SICC && UART0_TTYS1
	default y
endmenu
```
